## conf/layer.conf
```bitbake
# We have a conf and classes directory, add to BBPATH
BBPATH .= ":${LAYERDIR}"

# We have recipes-* directories, add to BBFILES
BBFILES += "${LAYERDIR}/recipes-*/*/*.bb \
            ${LAYERDIR}/recipes-*/*/*.bbappend"

BBFILE_COLLECTIONS += "meta-icathya"
BBFILE_PATTERN_meta-icathya := "^${LAYERDIR}/"
BBFILE_PRIORITY_meta-icathya = "10"

# Layer dependencies
LAYERDEPENDS_meta-icathya = "core fsl-bsp-release fsl-sdk-release"

# Compatible with Yocto releases
LAYERSERIES_COMPAT_meta-icathya = "scarthgap"

# Layer information
LAYER_INFO = "meta-icathya: Progressive learning layer for embedded Linux on NXP i.MX8MP platforms"
```
